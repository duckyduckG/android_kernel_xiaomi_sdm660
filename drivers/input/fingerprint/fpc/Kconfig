## drivers/input/fingerprint/fpc/Kconfig
```kconfig
#-----------------------------------#
#    Kconfig for FingerprintCard    #
#-----------------------------------#

config FPC_FINGERPRINT
	tristate "fpc1020 fingerprint driver"
	default n
	help
	add support for fpc1020 fingerprint driver.
```
